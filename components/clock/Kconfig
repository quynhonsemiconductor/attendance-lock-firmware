## components/clock/Kconfig
```kconfig
menu "Clock"

config CLOCK_SNTP_SERVER
    string "Primary NTP server"
    default "time.cloudflare.com"
    help
        The bounded sync session starts SNTP against this server and stops
        it again before the radio goes off (deep-sleep design).

config CLOCK_SNTP_SERVER_FALLBACK
    string "Fallback NTP server (empty = none)"
    default ""
    help
        Queried only when the primary is unreachable during the session.

endmenu
```

## components/door/Kconfig
```kconfig
menu "Door"

config DOOR_UNLOCK_HOLD_MS
    int "Milliseconds the lock stays released after an allowed tap"
    default 5000

config DOOR_FEEDBACK_GPIO_GREEN
    int "Feedback LED green GPIO"
    default 16

config DOOR_FEEDBACK_GPIO_RED
    int "Feedback LED red GPIO"
    default 47

config DOOR_FEEDBACK_GPIO_BUZZER
    int "Feedback buzzer GPIO"
    default 5

config DOOR_EXIT_BTN_GPIO
    int "Exit button GPIO (convenience unlock, inside)"
    default 6

config DOOR_EXIT_DEBOUNCE_MS
    int "Exit button debounce (ms)"
    default 40

endmenu
```

## components/door_fsm/Kconfig
```kconfig
menu "Door"

config DOOR_UNLOCK_HOLD_MS
    int "Milliseconds the lock stays released after an allowed tap"
    default 5000

config DOOR_FEEDBACK_GPIO_GREEN
    int "Feedback LED green GPIO"
    default 16

config DOOR_FEEDBACK_GPIO_RED
    int "Feedback LED red GPIO"
    default 47

config DOOR_FEEDBACK_GPIO_BUZZER
    int "Feedback buzzer GPIO"
    default 5

config DOOR_EXIT_GPIO
    int "Inside exit button GPIO (-1 = none; active low)"
    default -1
    range -1 21
    help
        KEY1 on the main board (2026-11-03): GPIO6, 10k pull-up to 3.3 V,
        100 nF to GND, the button shorts to GND. A press releases the bolt
        like an allowed tap (same hold window, green + single beep), once
        per press. SECURITY.md states free egress is mechanical (inside
        handle): this button is an ADDITIONAL egress and is off (-1) in the
        default profile until that decision is revisited. It must be an RTC
        GPIO (ESP32-S3: 0-21, enforced by the range): in deep sleep it wakes
        the chip (ext0, level low, which refuses any other pin) and the wake
        itself counts as the press.

config DOOR_EXIT_DEBOUNCE_MS
    int "Exit button debounce (ms)"
    default 50
    range 10 1000
    depends on DOOR_EXIT_GPIO >= 0

config DOOR_EXIT_STUCK_S
    int "Exit button held this long counts as stuck (s)"
    default 60
    range 5 3600
    depends on DOOR_EXIT_GPIO >= 0
    help
        A stuck button stops blocking deep sleep and is not armed as a wake
        source (it would re-wake the chip at once). It is re-armed once it
        reads released again.

endmenu
```

## components/lock/Kconfig
```kconfig
menu "Lock"

choice LOCK_BACKEND
    prompt "Lock backend"
    default LOCK_BACKEND_SERVO

config LOCK_BACKEND_RELAY
    bool "Relay / strike driver"

config LOCK_BACKEND_SERVO
    bool "Servo bolt (LEDC PWM)"

endchoice

config LOCK_RELAY_GPIO
    int "Relay GPIO"
    default 4

config LOCK_RELAY_ACTIVE
    int "Relay active level (1 = high)"
    default 1
    range 0 1

config LOCK_SERVO_GPIO
    int "Servo signal GPIO"
    default 4

config LOCK_SERVO_FREQ
    int "Servo PWM frequency (Hz)"
    default 50

config LOCK_SERVO_LOCK_US
    int "Servo pulse at the LOCKED position (µs)"
    default 1000

config LOCK_SERVO_UNLOCK_US
    int "Servo pulse at the RELEASED position (µs)"
    default 2000

config LOCK_SERVO_MOVE_MS
    int "Servo travel time (ms the pulse is held)"
    default 700

config LOCK_SERVO_RELEASE
    bool "Release the servo signal after the move (no holding current)"
    default y

config LOCK_SERVO_PWR_GPIO
    int "Servo power switch enable GPIO (-1 = servo always powered)"
    default -1
    range -1 48
    depends on LOCK_BACKEND_SERVO
    help
        Servo power switch board (pcb/servo-power-switch, 2026-11-03): EN on
        GPIO14 drives a P-MOSFET high-side switch on the servo's 6 V. The
        servo is powered only for a move: EN on, LOCK_SERVO_PWR_LEAD_MS for
        the rail to come up, the pulse, then pulse AND power off after
        LOCK_SERVO_MOVE_MS. With LOCK_SERVO_RELEASE=n the power stays on
        (the held pulse needs it). Held off through deep sleep.

config LOCK_SERVO_PWR_ACTIVE
    int "Servo power enable active level (1 = high turns the servo on)"
    default 1
    range 0 1
    depends on LOCK_SERVO_PWR_GPIO >= 0

config LOCK_SERVO_PWR_LEAD_MS
    int "Servo power-up time before the pulse starts (ms)"
    default 20
    range 0 200
    depends on LOCK_SERVO_PWR_GPIO >= 0

endmenu
```

## components/power/Kconfig
```kconfig
menu "Power"

config POWER_BATTERY_MONITOR
    bool "Battery voltage monitor"
    default y

config POWER_BATTERY_ADC_CHANNEL
    int "ADC1 channel for the divider tap (GPIO1 = channel 0)"
    default 0

config POWER_BATTERY_DIV_MUL
    int "Divider multiplier (pack mV per ...)"
    default 11

config POWER_BATTERY_DIV_DIV
    int "Divider denominator (pin mV × MUL / DIV = pack mV)"
    default 1

config POWER_BATTERY_MIN_MV
    int "Plausible reading: lower bound (pack mV)"
    default 3000
    help
        A reading below this is a sensor fault (open/shorted divider), not
        a pack level. BENCH-TEST.md: the pack is 4.5-6.5 V and the divider
        is 11:1, so the window is widened to 3.0-9.0 V to absorb ADC and
        divider tolerance; a floating tap reads full scale (~34 V).

config POWER_BATTERY_MAX_MV
    int "Plausible reading: upper bound (pack mV)"
    default 9000
    help
        A reading above this is a sensor fault (divider not wired, GPIO
        floating near full scale). Such a reading is never sent as
        battery_mv and never lets the release gate pass.

config POWER_BATTERY_LOW_MV
    int "Low-battery threshold (pack mV)"
    default 5000
    help
        Report-only alert at ~5.0 V; the regulator's effective cutoff is
        ~4.8 V.

config POWER_BATTERY_CUTOFF_MV
    int "Effective cutoff (pack mV)"
    default 4800
    help
        Below this the regulator drops out; releases are denied at
        cutoff + margin so the servo surge cannot brown the rail out.

config POWER_BATTERY_DENY_MARGIN_MV
    int "Release-deny margin above the cutoff (pack mV)"
    default 200
    range 0 2000

endmenu
```

## components/provision/Kconfig
```kconfig
menu "Provision"

config PROVISION_ALLOW_HTTP
    bool "Allow plain-http base URLs (dev bench only)"
    default n
    help
        When set, the provisioning console accepts an http:// base URL so
        the board can sync against a local opshub without TLS
        (docs/BENCH-TEST.md). Dev profile only: the prod build keeps this
        unset and rejects anything but https:// (asserted in CI).

endmenu
```

## components/reader/Kconfig
```kconfig
menu "Reader"

config READER_SPI_HOST
    int "SPI host (SPI2_HOST = 1, SPI3_HOST = 2)"
    default 2

config READER_SPI_SCK
    int "SPI SCK GPIO"
    default 12

config READER_SPI_MISO
    int "SPI MISO GPIO"
    default 13

config READER_SPI_MOSI
    int "SPI MOSI GPIO"
    default 11

config READER_CS_OUT
    int "Outside reader CS (IN lane) GPIO"
    default 10

config READER_CS_IN
    int "Inside reader CS (OUT lane) GPIO"
    default 9

config READER_RST_OUT
    int "Outside reader RST GPIO (hard reset + power-down)"
    default 17

config READER_RST_IN
    int "Inside reader RST GPIO"
    default 21

config READER_POLL_MS
    int "Milliseconds between card polls (RC522 powered down between)"
    default 400

config READER_DEBOUNCE_MS
    int "Same card + same reader: ignore re-reads within this window (ms)"
    default 1000

config READER_CROSS_READ_MS
    int "Same card on the other reader: suppress within this window (ms)"
    default 800

config READER_PIR_GPIO
    int "PIR presence sensor GPIO (-1 = no PIR: poll every READER_POLL_MS)"
    default -1
    range -1 48
    help
        Battery work 2026-11-01: an AM312 PIR (push-pull, ~3.3 V high while it
        sees motion, ~2 s retriggerable hold) gates the card polls. Motion
        wakes the chip (GPIO light-sleep wakeup) and starts fast polling;
        without motion the readers are only polled every READER_IDLE_POLL_MS.
        The PIR never decides an unlock — it only decides WHEN to scan.
        Bench wiring (2026-11-03): outside PIR on KSCL -> GPIO18.

config READER_PIR2_GPIO
    int "Second (inside) PIR GPIO (-1 = none)"
    default -1
    range -1 48
    depends on READER_PIR_GPIO >= 0
    help
        Same behaviour as READER_PIR_GPIO; either PIR starts fast polling
        (both readers) and either wakes the chip from deep sleep. Bench
        wiring (2026-11-03): inside PIR on KSDA -> GPIO8. For deep sleep both
        must be RTC GPIOs (ESP32-S3: 0-21).

config READER_PIR_ACTIVE_MS
    int "Fast polling continues this long after the PIR was last high (ms)"
    default 10000
    depends on READER_PIR_GPIO >= 0
    help
        Covers someone who stopped moving while finding the card: the 1 s
        tap-to-read target holds for this long after the last motion.

config READER_IDLE_POLL_MS
    int "Fallback poll period without motion (ms)"
    default 2000
    range 400 9000
    depends on READER_PIR_GPIO >= 0
    help
        A covered or missed PIR still gets a card read within this period
        (bench 2026-11-02: 5 s felt broken when a hand blocked the PIR).
        Must stay under the 10 s task watchdog.

config READER_PIR_DEBUG
    bool "Log every PIR level change seen by the reader task (bench)"
    default n
    depends on READER_PIR_GPIO >= 0
    help
        Logs "pir: GPIOn level 0/1 (isr N)" whenever the sampled level changes,
        to tell a PIR that never drives the pin high (wiring, output level
        under the ESP32-S3 VIH of ~2.5 V) from an interrupt that never fires.

endmenu
```

## components/sleep/Kconfig
```kconfig
menu "Deep sleep"

config SLEEP_DEEP_ENABLE
    bool "Deep sleep between PIR wakes and sync sessions"
    default n
    depends on READER_PIR_GPIO >= 0
    help
        Battery work 2026-11-03. With the bolt engaged, no feedback running,
        no sync session due and no motion for READER_PIR_ACTIVE_MS, the chip
        enters deep sleep. It wakes on a PIR going high (ext1, any of the
        configured PIRs) or on the RTC timer when the next sync session is
        due. A wake restarts the firmware: the bolt is NOT driven again
        (it stayed engaged), the allow-list and the event ring come from
        NVS, the clock base and the sync schedule from RTC memory.

        There is no fallback poll while asleep: a covered PIR means a card
        is not read until someone moves in front of it.

config SLEEP_BOOT_AWAKE_S
    int "Stay awake after power-on / reset (s): provisioning console window"
    default 120
    range 10 3600
    depends on SLEEP_DEEP_ENABLE
    help
        The UART console only answers while the chip is awake. After a
        power-on or a reset (EN button) it stays awake this long; console
        input keeps it awake for SLEEP_CONSOLE_IDLE_S more.

config SLEEP_CONSOLE_IDLE_S
    int "Console input keeps the chip awake this long (s)"
    default 60
    range 5 3600
    depends on SLEEP_DEEP_ENABLE

config SLEEP_PIR_STUCK_S
    int "A PIR high this long without a break is ignored (s)"
    default 60
    range 10 3600
    depends on SLEEP_DEEP_ENABLE
    help
        A stuck-high PIR would keep the chip awake forever (ext1 wakes on a
        high level). Past this time it stops counting as motion and is left
        out of the wake mask until it drops again.

endmenu
```

## components/sync/Kconfig
```kconfig
menu "Sync"

config SYNC_INTERVAL_MIN
    int "Minutes between sync sessions"
    default 60
    range 1 1440
    help
        The bounded session (Wi-Fi up, SNTP, allow-list poll, event upload,
        Wi-Fi down) runs once per interval. Designed so the main loop can
        replace the delay with a deep-sleep timer wake.

endmenu
```
